## config/boards/shields/vibeboard/Kconfig.defconfig
```kconfig
if SHIELD_VIBEBOARD
    
config ZMK_KEYBOARD_NAME
    default "vibeboard"

endif
```

## config/west.yml
```yaml
manifest:
  defaults:
    revision: v0.3
  remotes:
    - name: zmkfirmware
      url-base: https://github.com/zmkfirmware
    - name: mctechnology17
      url-base: https://github.com/mctechnology17
    # Additional modules containing boards/shields/custom code can be listed here as well
    # See https://docs.zephyrproject.org/3.2.0/develop/west/manifest.html#projects
  projects:
    - name: zmk
      remote: zmkfirmware
      import: app/west.yml
    - name: zmk-switch-layout
      remote: mctechnology17
      revision: e6e1802dd00f46d58c35c88d9b35a69f4bed9b88
  self:
    path: config
```
